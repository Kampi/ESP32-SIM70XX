## Kconfig
```kconfig
menu "SIM70XX"
    choice 
        prompt "Target device"
        config SIM70XX_DEV_SIM7020
            bool "SIM7020"
            help
                Enable support for the SIM7020 NB-IoT modem.

        config SIM70XX_DEV_SIM7080
            bool "SIM7080"
            help
                Enable support for the SIM7080 LTE Cat-M and NB-IoT modem.
    endchoice

    config SIMXX_DEV
        int
        default 7020 if SIM70XX_DEV_SIM7020
        default 7080 if SIM70XX_DEV_SIM7080

    menu "FreeRTOS"
        config SIM70XX_TASK_CORE_AFFINITY
            bool "Communication task core affinity"
            default y
            help
                Enable this option if you want to use a specific core for the driver.

        config SIM70XX_TASK_COM_CORE
            int "Communication task core"
            range 0 1
            default 1
            depends on SIM7020_TASK_CORE_AFFINITY
            help
                Use a specific core for the communication task.

        config SIM70XX_TASK_evt_PRIO
            int "Communication task priority"
            range 12 25
            default 12
            help
                Task priority for the communication task.

        config SIM70XX_TASK_evt_STACK
            int "Communication task stack size"
            range 4096 16384
            default 4096
            help
                Stack size for the communication task.
        
        config SIM70XX_QUEUE_LENGTH
            int "Communication task queue length"
            range 8 32
            default 16
            help
                Event queue length for the communication task.
    endmenu

    menu "Drivers"
        config SIM70XX_DRIVER_WITH_COAP
            bool "Enable CoAP support"
            depends on (SIM70XX_DEV_SIM7080 || SIM70XX_DEV_SIM7020)
            default n
            help
                Enable this option if you want CoAP support added to the driver.

        config SIM70XX_DRIVER_WITH_MQTT
            bool "Enable MQTT support"
            depends on (SIM70XX_DEV_SIM7080 || SIM70XX_DEV_SIM7020)
            default n
            help
                Enable this option if you want MQTT support added to the driver.

        config SIM70XX_DRIVER_WITH_HTTP
            bool "Enable HTTP support"
            depends on (SIM70XX_DEV_SIM7080 || SIM70XX_DEV_SIM7020)
            default n
            help
                Enable this option if you want HTTP support added to the driver.

        config SIM70XX_DRIVER_WITH_TCPIP
            bool "Enable TCP/IP support"
            depends on (SIM70XX_DEV_SIM7080 || SIM70XX_DEV_SIM7020)
            default n
            help
                Enable this option if you want TCP/IP support added to the driver.

        config SIM70XX_DRIVER_WITH_NTP
            bool "Enable NTP support"
            depends on (SIM70XX_DEV_SIM7080 || SIM70XX_DEV_SIM7020)
            default n
            help
                Enable this option if you want NTP support added to the driver.

        config SIM70XX_DRIVER_WITH_DNS
            bool "Enable DNS support"
            depends on (SIM70XX_DEV_SIM7080 || SIM70XX_DEV_SIM7020)
            default n
            help
                Enable this option if you want DNS support added to the driver.
	
        config SIM70XX_DRIVER_WITH_GPS
            bool "Enable GPS support"
            depends on SIM70XX_DEV_SIM7080
            default n
            help
                Enable this option if you want GPS support added to the driver.

        config SIM70XX_DRIVER_WITH_FS
            bool "Enable File System support"
            depends on SIM70XX_DEV_SIM7080
            default n
            help
                Enable this option if you want File System support added to the driver.

        config SIM70XX_DRIVER_WITH_EMAIL
            bool "Enable E-Mail support"
            depends on SIM70XX_DEV_SIM7080
            default n
            help
                Enable this option if you want E-Mail support added to the driver.

        config SIM70XX_DRIVER_WITH_NVRAM
            bool "Enable NVRAM support"
            depends on SIM70XX_DEV_SIM7020
            default n
            help
                Enable this option if you want NWR support added to the driver.

    endmenu

    menu "UART"
        config SIM70XX_UART_BUFFER_SIZE
            int "UART buffer size"
            range 128 1024
            default 256
            help
                UART communication buffer size.
    endmenu

    menu "Reset"
        depends on SIM70XX_DEV_SIM7020
        config SIM70XX_RESET_USE_HW
            bool "Enable hardware reset"
            default n
            help
                Enable this option if you want to use a hardware reset through an IO.
    endmenu

    menu "Misc"
        config SIM70XX_MISC_ERROR_BASE
            hex "SIMXX driver error base definition"
            range 0 FFFF
            default 0x9000
            help
                Set the error base for the driver.
    endmenu
endmenu
```

## examples/Kconfig
```kconfig
menu "Demo"
    config DEMO_READ_OPERATOR
        bool "Read the available operators"

    menu "NTP"
	    depends on SIM70XX_DRIVER_WITH_NTP

        config DEMO_USE_SNTP
            bool "Enable the SNTP demo"

        config DEMO_SNTP_HOST
	        depends on DEMO_USE_SNTP
            string "Server address"
			default "de.pool.ntp.org"

		config DEMO_SNTP_TIMEZONE
	        depends on DEMO_USE_SNTP
            int "Timezone"
			default 0
			range -47 48
	endmenu

	menu "E-Mail"
	    depends on SIM70XX_DRIVER_WITH_EMAIL

        config DEMO_USE_EMAIL
            bool "Enable the E-Mail demo"

        config DEMO_SNTP_SERVER
	        depends on DEMO_USE_EMAIL
            string "Server address"

        config DEMO_SNTP_PORT
	        depends on DEMO_USE_EMAIL
            int "Server port"
            range 0 65535
			default 465

        config DEMO_SNTP_USER
	        depends on DEMO_USE_EMAIL
            string "SNTP user"

        config DEMO_SNTP_PASSWORD
	        depends on DEMO_USE_EMAIL
            string "SNTP password"

        config DEMO_USE_POP3
            bool "Enable POP3 support to receive e-mails"

        config DEMO_POP3_SERVER
	        depends on DEMO_USE_POP3
            string "POP3 Server address"

        config DEMO_POP3_PORT
	        depends on DEMO_USE_POP3
            int "POP3 Server port"
            range 0 65535
			default 995
	endmenu

	menu "UDP"
	    depends on SIM70XX_DRIVER_WITH_TCPIP

        config DEMO_USE_UDP_CLIENT
            bool "Enable the UDP client demo"

        config DEMO_UDP_CLIENT_HOST
	        depends on DEMO_USE_UDP_CLIENT
            string "Server address"

		config DEMO_UDP_CLIENT_PORT
	        depends on DEMO_USE_UDP_CLIENT
            int "Server port"
            range 0 65535
			default 5246
	endmenu

	menu "TCP/IP"
	    depends on SIM70XX_DRIVER_WITH_TCPIP

        config DEMO_USE_TCPIP_CLIENT
            select SIM70XX_DRIVER_WITH_DNS
            bool "Enable the TCP/IP client demo"

        config DEMO_TCP_CLIENT_HOST
	        depends on DEMO_USE_TCPIP_CLIENT
            string "Server address"
            default "webhook.site"

		config DEMO_TCP_CLIENT_PORT
	        depends on DEMO_USE_TCPIP_CLIENT
            int "Server port"
            range 0 65535
			default 80

        config DEMO_TCP_CLIENT_ENDPOINT
	        depends on DEMO_USE_TCPIP_CLIENT
            string "Server endpoint"

        config DEMO_USE_TCPIP_SERVER
            bool "Enable the TCP/IP server demo"

		config DEMO_TCP_SERVER_PORT
	        depends on DEMO_USE_TCPIP_SERVER
            int "Server port"
            range 0 65535
			default 5678
	endmenu

	menu "File System"
	    depends on SIM70XX_DRIVER_WITH_FS

        config DEMO_USE_FS
            bool "Enable the FS demo"
	endmenu

	menu "NVRAM"
	    depends on SIM70XX_DRIVER_WITH_NVRAM

        config DEMO_USE_NVRAM
            bool "Enable the NVRAM demo"
	endmenu

	menu "SSL"
	    depends on SIM70XX_DRIVER_WITH_SSL

        config DEMO_USE_SSL
            bool "Enable the SSL support for the demos"
	endmenu

	menu "MQTT"
	    depends on SIM70XX_DRIVER_WITH_MQTT

        config DEMO_USE_MQTT
            bool "Enable the MQTT demo"

        config DEMO_MQTT_BROKER
	        depends on DEMO_USE_MQTT
            string "Broker address"
            default "test.mosquitto.org"

		config DEMO_MQTT_PORT
	        depends on DEMO_USE_MQTT
            int "Broker port"
            range 0 65535
			default 1883

        config DEMO_MQTT_USE_LOGIN
	        depends on DEMO_USE_MQTT
            bool "Use login credentials"

		config DEMO_MQTT_USER
	        depends on DEMO_USE_MQTT
            string "MQTT user"
            default "roger"
            depends on DEMO_MQTT_USE_LOGIN

		config DEMO_MQTT_PASSWORD
	        depends on DEMO_USE_MQTT
            string "MQTT password"
            default "password"
            depends on DEMO_MQTT_USE_LOGIN

        config DEMO_MQTT_KEEPALIVE
	        depends on DEMO_USE_MQTT
            int "Connection keep alive time"
            range 0 65535
            default 60
	endmenu

	menu "CoAP"
	    depends on SIM70XX_DRIVER_WITH_COAP

        config DEMO_USE_COAP
            select SIM70XX_DRIVER_WITH_DNS
            bool "Enable the CoAP demo"

        config DEMO_COAP_SERVER
	        depends on DEMO_USE_COAP
            string "Server address"
            default "coap.me"

		config DEMO_COAP_PORT
	        depends on DEMO_USE_COAP
            int "Broker port"
            range 0 65535
			default 5683
	endmenu

	menu "HTTP"
	    depends on SIM70XX_DRIVER_WITH_HTTP

        config DEMO_USE_HTTP
            bool "Enable the HTTP demo"

        config DEMO_HTTP_SERVER
	        depends on DEMO_USE_HTTP
            string "Server address"
            default "http://www.webhook.site"

        config DEMO_HTTP_ENDPOINT
	        depends on DEMO_USE_HTTP
            string "Server endpoint"
            default "/b9751a25-0f1b-4cd1-9161-b27b8958e2d6"
	endmenu
endmenu
```
